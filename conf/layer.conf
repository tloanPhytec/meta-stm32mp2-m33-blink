## conf/layer.conf
```bitbake
BBPATH .= ":${LAYERDIR}"
BBFILES += "${LAYERDIR}/recipes-*/*/*.bbappend"
BBFILE_COLLECTIONS += "stm32mp2_m33_blink"
BBFILE_PATTERN_stm32mp2_m33_blink = "^${LAYERDIR}/"
BBFILE_PRIORITY_stm32mp2_m33_blink = "100"
LAYERSERIES_COMPAT_stm32mp2_m33_blink = "scarthgap"
LAYERDEPENDS_stm32mp2_m33_blink = "core stm-st-stm32mp phytec"

# Avoid the existing devtool externalsrc and oe-local-files overrides.
# Its source checkout remains untouched.
BBMASK += ".*/workspace/appends/m33projects-stm32mp2[.]bbappend$"
```
